## configs/trafficlight_defconfig
```kconfig
BR2_arm=y
BR2_cortex_a7=y
BR2_ARM_FPU_NEON_VFPV4=y
BR2_TOOLCHAIN_BUILDROOT_GLIBC=y
BR2_PACKAGE_HOST_LINUX_HEADERS_CUSTOM_4_14=y
BR2_TOOLCHAIN_BUILDROOT_CXX=y
BR2_TARGET_GENERIC_HOSTNAME="trafficlight"
BR2_TARGET_GENERIC_ISSUE="Welcome to trafficlight"
BR2_INIT_SYSV=y
BR2_TARGET_GENERIC_ROOT_PASSWD="linux"
# BR2_TARGET_GENERIC_REMOUNT_ROOTFS_RW is not set
BR2_SYSTEM_DHCP="eth0"
BR2_ROOTFS_POST_BUILD_SCRIPT="board/trafficlight/post-build.sh"
BR2_ROOTFS_POST_IMAGE_SCRIPT="board/trafficlight/post-image.sh"
BR2_LINUX_KERNEL=y
BR2_LINUX_KERNEL_CUSTOM_TARBALL=y
BR2_LINUX_KERNEL_CUSTOM_TARBALL_LOCATION="$(call github,raspberrypi,linux,6d27aa156c26977dfd079a7107e31670127d17d3)/linux-6d27aa156c26977dfd079a7107e31670127d17d3.tar.gz"
BR2_LINUX_KERNEL_DEFCONFIG="bcm2709"
BR2_LINUX_KERNEL_CONFIG_FRAGMENT_FILES="board/trafficlight/kernel-fragment.config"
BR2_LINUX_KERNEL_DTS_SUPPORT=y
BR2_LINUX_KERNEL_INTREE_DTS_NAME="bcm2709-rpi-2-b"
BR2_PACKAGE_TRAFFICLIGHT_INITRAMFS=y
BR2_PACKAGE_CLEWARECONTROL=y
BR2_PACKAGE_RPI_FIRMWARE=y
# BR2_PACKAGE_RPI_FIRMWARE_INSTALL_DTB_OVERLAYS is not set
BR2_PACKAGE_PYTHON3=y
BR2_PACKAGE_AVAHI=y
BR2_PACKAGE_AVAHI_DAEMON=y
BR2_PACKAGE_AVAHI_LIBDNSSD_COMPATIBILITY=y
BR2_TARGET_ROOTFS_SQUASHFS=y
# BR2_TARGET_ROOTFS_TAR is not set
BR2_PACKAGE_HOST_DOSFSTOOLS=y
BR2_PACKAGE_HOST_E2FSPROGS=y
BR2_PACKAGE_HOST_GENIMAGE=y
BR2_PACKAGE_HOST_MTOOLS=y
BR2_PACKAGE_CONNMAN=y
```

## package/clewarecontrol/Config.in
```kconfig
config BR2_PACKAGE_CLEWARECONTROL
	bool "clewarecontrol"
	select BR2_PACKAGE_PYTHON_FLASK
```

## package/trafficlight-initramfs/Config.in
```kconfig
config BR2_PACKAGE_TRAFFICLIGHT_INITRAMFS
	bool "Trafficlight initramfs"
	default n
	help
	  A simple initramfs based on busybox.

	  http://busybox.net/
```
